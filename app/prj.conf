## CMakeLists.txt
```
cmake_minimum_required(VERSION 3.20.0)

find_package(Zephyr REQUIRED HINTS $ENV{ZEPHYR_BASE})
project(specialized_test)

target_include_directories(app PRIVATE include)

target_sources(app PRIVATE
	src/main.c
	src/app_config_model.c
	src/zephyr_app_config.c
	src/app_logic.c
	src/can_formatter.c
	src/runtime.c
)
```

## Kconfig
```
mainmenu "Specialized Test Application"

menu "CAN bus configuration"

config APP_CAN_BITRATE
	int "CAN bitrate (bps)"
	range 10000 1000000
	default 500000

config APP_CAN_SAMPLE_POINT_PERMILLE
	int "CAN sample point (permille)"
	range 500 950
	default 875

config APP_CAN_LOOPBACK
	bool "Enable CAN loopback mode"
	default y if BOARD_NATIVE_SIM
	default n
	help
	  Required to validate RX/TX on native_sim without physical hardware.
	  Should stay disabled by default on real boards with a physical bus.

config APP_CAN_RX_QUEUE_DEPTH
	int "CAN RX message queue depth"
	range 1 64
	default 8

endmenu

menu "Periodic TX messages"

config APP_TX1_ID
	hex "TX1 CAN ID"
	range 0x0 0x7FF if !APP_TX1_EXTENDED_ID
	range 0x0 0x1FFFFFFF if APP_TX1_EXTENDED_ID
	default 0x100

config APP_TX1_EXTENDED_ID
	bool "TX1 uses extended (29-bit) CAN ID"
	default n

config APP_TX1_PERIOD_MS
	int "TX1 period (ms)"
	range 1 3600000
	default 1000

config APP_TX2_ID
	hex "TX2 CAN ID"
	range 0x0 0x7FF if !APP_TX2_EXTENDED_ID
	range 0x0 0x1FFFFFFF if APP_TX2_EXTENDED_ID
	default 0x101

config APP_TX2_EXTENDED_ID
	bool "TX2 uses extended (29-bit) CAN ID"
	default n

config APP_TX2_PERIOD_MS
	int "TX2 period (ms)"
	range 1 3600000
	default 500

config APP_TX3_ID
	hex "TX3 CAN ID"
	range 0x0 0x7FF if !APP_TX3_EXTENDED_ID
	range 0x0 0x1FFFFFFF if APP_TX3_EXTENDED_ID
	default 0x102

config APP_TX3_EXTENDED_ID
	bool "TX3 uses extended (29-bit) CAN ID"
	default n

config APP_TX3_PERIOD_MS
	int "TX3 period (ms)"
	range 1 3600000
	default 250

endmenu

menu "Optional triggers"

config APP_START_TRIGGER_ENABLE
	bool "Enable start trigger"
	default n

config APP_START_TRIGGER_ID
	hex "Start trigger CAN ID"
	range 0x0 0x7FF if !APP_START_TRIGGER_EXTENDED_ID
	range 0x0 0x1FFFFFFF if APP_START_TRIGGER_EXTENDED_ID
	default 0x200

config APP_START_TRIGGER_EXTENDED_ID
	bool "Start trigger uses extended (29-bit) CAN ID"
	default n

config APP_STOP_TRIGGER_ENABLE
	bool "Enable stop trigger"
	default n

config APP_STOP_TRIGGER_ID
	hex "Stop trigger CAN ID"
	range 0x0 0x7FF if !APP_STOP_TRIGGER_EXTENDED_ID
	range 0x0 0x1FFFFFFF if APP_STOP_TRIGGER_EXTENDED_ID
	default 0x201

config APP_STOP_TRIGGER_EXTENDED_ID
	bool "Stop trigger uses extended (29-bit) CAN ID"
	default n

config APP_HELLO_TRIGGER_ENABLE
	bool "Enable hello trigger"
	default n

config APP_HELLO_TRIGGER_ID
	hex "Hello trigger CAN ID"
	range 0x0 0x7FF if !APP_HELLO_TRIGGER_EXTENDED_ID
	range 0x0 0x1FFFFFFF if APP_HELLO_TRIGGER_EXTENDED_ID
	default 0x202

config APP_HELLO_TRIGGER_EXTENDED_ID
	bool "Hello trigger uses extended (29-bit) CAN ID"
	default n

endmenu

menu "Smoke test (native_sim only)"

config APP_SMOKE_TEST_INJECT_TRIGGERS
	bool "Inject start/hello/stop trigger frames once after boot"
	default n
	help
	  Sends the configured start, hello and stop trigger CAN IDs once
	  each, a fixed delay apart, shortly after boot (only the ones with
	  their *_TRIGGER_ENABLE option on). This is the only way to
	  exercise the full start/stop/hello lifecycle on native_sim's
	  loopback CAN device without a second physical bus peer.

	  Intended only for the native_sim smoke scenario
	  (test/native-sim-smoke / prj_smoke.conf). Never enable this on
	  real hardware: it injects traffic that looks like it came from
	  another node on the bus.

endmenu

source "Kconfig.zephyr"
```

## prj.conf
```kconfig
CONFIG_CONSOLE=y
CONFIG_PRINTK=y
CONFIG_CAN=y
CONFIG_ENTROPY_GENERATOR=y
```

## prj_smoke.conf
```kconfig
# Overlay for the native_sim smoke scenario (test/native-sim-smoke).
# Enables all three optional triggers and the one-shot trigger injector,
# so a single native_sim run demonstrates the full start/stop/hello
# lifecycle without a second CAN bus peer. Build with:
#
#   west build -p always -b native_sim app -- -DEXTRA_CONF_FILE=prj_smoke.conf
#
# Never combine this overlay with a real board.

CONFIG_APP_START_TRIGGER_ENABLE=y
CONFIG_APP_STOP_TRIGGER_ENABLE=y
CONFIG_APP_HELLO_TRIGGER_ENABLE=y
CONFIG_APP_SMOKE_TEST_INJECT_TRIGGERS=y
```

## src/main.c
```c
#include <zephyr/kernel.h>
#include <zephyr/sys/printk.h>

#include "specialized/app_config_model.h"
#include "specialized/runtime.h"
#include "specialized/zephyr_app_config.h"

int main(void)
{
	struct app_config config;
	enum app_config_validation_result result;
	int ret;

	printk("Specialized Test booted on %s\n", CONFIG_BOARD);

	zephyr_app_config_load(&config);

	result = app_config_validate(&config);
	if (result != APP_CONFIG_OK) {
		printk("Invalid build-time configuration: %s\n",
		       app_config_validation_result_to_str(result));
		k_panic();
	}

	printk("Build-time configuration validated\n");

	ret = runtime_start_periodic_tx(&config);
	if (ret != 0) {
		printk("Failed to start periodic CAN TX: %d\n", ret);
		k_panic();
	}

	ret = runtime_start_rx_printer(&config);
	if (ret != 0) {
		printk("Failed to start CAN RX printer: %d\n", ret);
		k_panic();
	}

	ret = runtime_start_smoke_injector(&config);
	if (ret != 0) {
		printk("Failed to start smoke trigger injector: %d\n", ret);
		k_panic();
	}

	return 0;
}
```

## src/app_config_model.c
```c
#include <stddef.h>

#include "specialized/app_config_model.h"

#define APP_CONFIG_ARRAY_SIZE(arr) (sizeof(arr) / sizeof((arr)[0]))

static bool id_in_range(uint32_t id, bool extended_id)
{
	uint32_t max_id = extended_id ? APP_CONFIG_MAX_EXT_CAN_ID : APP_CONFIG_MAX_STD_CAN_ID;

	return id <= max_id;
}

static bool can_bus_valid(const struct app_can_bus_config *can)
{
	if (can->bitrate < APP_CONFIG_MIN_BITRATE || can->bitrate > APP_CONFIG_MAX_BITRATE) {
		return false;
	}

	if (can->sample_point_permille < APP_CONFIG_MIN_SAMPLE_POINT_PERMILLE ||
	    can->sample_point_permille > APP_CONFIG_MAX_SAMPLE_POINT_PERMILLE) {
		return false;
	}

	if (can->rx_queue_depth < APP_CONFIG_MIN_RX_QUEUE_DEPTH ||
	    can->rx_queue_depth > APP_CONFIG_MAX_RX_QUEUE_DEPTH) {
		return false;
	}

	return true;
}

/* A standard ID and an extended ID that share the same numeric value are
 * distinct CAN identifiers, so the extended flag is part of identity here.
 */
static bool same_can_id(uint32_t id_a, bool extended_a, uint32_t id_b, bool extended_b)
{
	return id_a == id_b && extended_a == extended_b;
}

static bool triggers_collide(const struct app_trigger_config *a, const struct app_trigger_config *b)
{
	return a->enabled && b->enabled && same_can_id(a->id, a->extended_id, b->id, b->extended_id);
}

static bool tx_collides_with_trigger(const struct app_tx_message_config *tx,
				      const struct app_trigger_config *trigger)
{
	return trigger->enabled &&
	       same_can_id(tx->id, tx->extended_id, trigger->id, trigger->extended_id);
}

enum app_config_validation_result app_config_validate(const struct app_config *config)
{
	if (config == NULL) {
		return APP_CONFIG_ERR_NULL_CONFIG;
	}

	if (!can_bus_valid(&config->can)) {
		return APP_CONFIG_ERR_INVALID_CAN_BUS;
	}

	const struct app_trigger_config *triggers[] = {
		&config->start_trigger,
		&config->stop_trigger,
		&config->hello_trigger,
	};

	for (size_t i = 0; i < APP_CONFIG_TX_COUNT; i++) {
		const struct app_tx_message_config *tx = &config->tx[i];

		if (tx->period_ms == 0) {
			return APP_CONFIG_ERR_ZERO_PERIOD;
		}

		if (!id_in_range(tx->id, tx->extended_id)) {
			return APP_CONFIG_ERR_INVALID_ID;
		}
	}

	for (size_t i = 0; i < APP_CONFIG_ARRAY_SIZE(triggers); i++) {
		if (triggers[i]->enabled && !id_in_range(triggers[i]->id, triggers[i]->extended_id)) {
			return APP_CONFIG_ERR_INVALID_ID;
		}
	}

	if (triggers_collide(&config->start_trigger, &config->stop_trigger) ||
	    triggers_collide(&config->start_trigger, &config->hello_trigger) ||
	    triggers_collide(&config->stop_trigger, &config->hello_trigger)) {
		return APP_CONFIG_ERR_TRIGGER_COLLISION;
	}

	for (size_t i = 0; i < APP_CONFIG_TX_COUNT; i++) {
		const struct app_tx_message_config *tx = &config->tx[i];

		for (size_t j = 0; j < APP_CONFIG_ARRAY_SIZE(triggers); j++) {
			if (tx_collides_with_trigger(tx, triggers[j])) {
				return APP_CONFIG_ERR_TX_TRIGGER_COLLISION;
			}
		}
	}

	return APP_CONFIG_OK;
}

const char *app_config_validation_result_to_str(enum app_config_validation_result result)
{
	switch (result) {
	case APP_CONFIG_OK:
		return "ok";
	case APP_CONFIG_ERR_NULL_CONFIG:
		return "null config pointer";
	case APP_CONFIG_ERR_INVALID_CAN_BUS:
		return "invalid CAN bus parameters (bitrate, sample point or RX queue depth)";
	case APP_CONFIG_ERR_ZERO_PERIOD:
		return "a periodic TX message has a zero period";
	case APP_CONFIG_ERR_INVALID_ID:
		return "a CAN ID is out of range for its standard/extended kind";
	case APP_CONFIG_ERR_TRIGGER_COLLISION:
		return "two optional triggers share the same CAN ID";
	case APP_CONFIG_ERR_TX_TRIGGER_COLLISION:
		return "a periodic TX message shares its CAN ID with a trigger";
	default:
		return "unknown validation error";
	}
}
```

## src/app_logic.c
```c
#include <stddef.h>

#include "specialized/app_logic.h"

static bool message_matches_trigger(const struct app_can_message *message,
				     const struct app_trigger_config *trigger)
{
	return trigger->enabled && message->id == trigger->id &&
	       message->extended_id == trigger->extended_id;
}

bool app_logic_init(struct app_logic_state *state, const struct app_trigger_config *start_trigger,
		     const struct app_trigger_config *stop_trigger,
		     const struct app_trigger_config *hello_trigger)
{
	if (state == NULL || start_trigger == NULL || stop_trigger == NULL ||
	    hello_trigger == NULL) {
		return false;
	}

	state->start_trigger = *start_trigger;
	state->stop_trigger = *stop_trigger;
	state->hello_trigger = *hello_trigger;
	state->printing_enabled = !start_trigger->enabled;

	return true;
}

enum app_logic_action app_logic_handle_message(struct app_logic_state *state,
						const struct app_can_message *message)
{
	if (state == NULL || message == NULL) {
		return APP_LOGIC_ACTION_INVALID_ARGS;
	}

	if (message_matches_trigger(message, &state->hello_trigger)) {
		return APP_LOGIC_ACTION_HELLO;
	}

	if (message_matches_trigger(message, &state->start_trigger)) {
		state->printing_enabled = true;
		return APP_LOGIC_ACTION_NONE;
	}

	if (message_matches_trigger(message, &state->stop_trigger)) {
		state->printing_enabled = false;
		return APP_LOGIC_ACTION_NONE;
	}

	return state->printing_enabled ? APP_LOGIC_ACTION_PRINT : APP_LOGIC_ACTION_NONE;
}
```

## src/can_formatter.c
```c
#include <inttypes.h>
#include <stdio.h>

#include "specialized/can_formatter.h"

static void format_payload(const struct app_can_message *message, char *data_str,
			    size_t data_str_size)
{
	size_t offset = 0;

	data_str[0] = '\0';

	for (uint8_t i = 0; i < message->dlc; i++) {
		int written = snprintf(&data_str[offset], data_str_size - offset, "%s%02X",
					i == 0 ? "" : " ", message->data[i]);

		if (written < 0 || (size_t)written >= data_str_size - offset) {
			break;
		}
		offset += (size_t)written;
	}
}

enum can_formatter_result can_formatter_format(const struct app_can_message *message, char *buf,
						size_t buf_size, size_t *out_len)
{
	char data_str[3 * APP_CAN_MESSAGE_MAX_DLC];
	int written;

	if (message == NULL || (buf == NULL && buf_size > 0)) {
		return CAN_FORMATTER_ERR_NULL_ARG;
	}

	if (message->dlc > APP_CAN_MESSAGE_MAX_DLC) {
		return CAN_FORMATTER_ERR_INVALID_DLC;
	}

	format_payload(message, data_str, sizeof(data_str));

	written = snprintf(buf, buf_size, "[%" PRIu64 " ms] ID=0x%X (%s) DLC=%u DATA=%s",
			    message->timestamp_ms, message->id,
			    message->extended_id ? "EXT" : "STD", message->dlc, data_str);

	if (written < 0) {
		return CAN_FORMATTER_ERR_FORMAT_FAILED;
	}

	if (out_len != NULL) {
		*out_len = (size_t)written;
	}

	if ((size_t)written >= buf_size) {
		return CAN_FORMATTER_ERR_BUFFER_TOO_SMALL;
	}

	return CAN_FORMATTER_OK;
}
```

## src/runtime.c
```c
#include <errno.h>
#include <stddef.h>
#include <string.h>

#include <zephyr/device.h>
#include <zephyr/drivers/can.h>
#include <zephyr/kernel.h>
#include <zephyr/random/random.h>
#include <zephyr/sys/printk.h>

#include "specialized/app_can_message.h"
#include "specialized/app_logic.h"
#include "specialized/can_formatter.h"
#include "specialized/runtime.h"

#define RX_THREAD_STACK_SIZE 1024
#define RX_THREAD_PRIORITY 5

static const struct device *const can_dev = DEVICE_DT_GET(DT_CHOSEN(zephyr_canbus));

struct tx_context {
	struct k_work_delayable work;
	struct can_frame frame;
	uint32_t period_ms;
};

static struct tx_context tx_contexts[APP_CONFIG_TX_COUNT];
static bool runtime_started;

static void tx_work_handler(struct k_work *work)
{
	struct k_work_delayable *dwork = k_work_delayable_from_work(work);
	struct tx_context *ctx = CONTAINER_OF(dwork, struct tx_context, work);
	int ret;

	sys_rand_get(ctx->frame.data, ctx->frame.dlc);

	ret = can_send(can_dev, &ctx->frame, K_MSEC(100), NULL, NULL);
	if (ret != 0) {
		printk("CAN TX failed for ID 0x%x: %d\n", ctx->frame.id, ret);
	} else {
		printk("CAN TX sent ID 0x%x DLC %u\n", ctx->frame.id, ctx->frame.dlc);
	}

	k_work_reschedule(dwork, K_MSEC(ctx->period_ms));
}

static int configure_can_bus(const struct app_can_bus_config *can)
{
	struct can_timing timing;
	int ret;

	/* can_set_mode()/can_set_timing() must run before can_start(); the
	 * driver rejects them with -EBUSY once the device is started.
	 */
	ret = can_set_mode(can_dev, can->loopback ? CAN_MODE_LOOPBACK : 0);
	if (ret != 0) {
		return ret;
	}

	ret = can_calc_timing(can_dev, &timing, can->bitrate, can->sample_point_permille);
	if (ret < 0) {
		return ret;
	}

	return can_set_timing(can_dev, &timing);
}

int runtime_start_periodic_tx(const struct app_config *config)
{
	int ret;

	if (config == NULL) {
		return -EINVAL;
	}

	/* Not designed to reconfigure a running bus: can_set_mode() and
	 * can_set_timing() reject calls once the device is started, so a
	 * second call would otherwise fail with -EBUSY instead of being a
	 * harmless no-op.
	 */
	if (runtime_started) {
		return 0;
	}

	if (!device_is_ready(can_dev)) {
		return -ENODEV;
	}

	ret = configure_can_bus(&config->can);
	if (ret != 0) {
		return ret;
	}

	ret = can_start(can_dev);
	if (ret != 0 && ret != -EALREADY) {
		return ret;
	}

	for (size_t i = 0; i < APP_CONFIG_TX_COUNT; i++) {
		struct tx_context *ctx = &tx_contexts[i];

		ctx->frame.id = config->tx[i].id;
		ctx->frame.flags = config->tx[i].extended_id ? CAN_FRAME_IDE : 0;
		ctx->frame.dlc = APP_CAN_MESSAGE_MAX_DLC;
		ctx->period_ms = config->tx[i].period_ms;

		k_work_init_delayable(&ctx->work, tx_work_handler);
		k_work_schedule(&ctx->work, K_MSEC(ctx->period_ms));
	}

	runtime_started = true;

	return 0;
}

/* The RX queue depth is a build-time setting, so the msgq uses the Kconfig
 * value directly. The same value is copied into app_config and validated at
 * boot, keeping the documented configuration and runtime storage aligned.
 */
CAN_MSGQ_DEFINE(rx_msgq, CONFIG_APP_CAN_RX_QUEUE_DEPTH);
K_THREAD_STACK_DEFINE(rx_thread_stack, RX_THREAD_STACK_SIZE);

static struct k_thread rx_thread_data;
static bool rx_printer_started;
static struct app_logic_state rx_logic_state;

static void frame_to_message(const struct can_frame *frame, struct app_can_message *message)
{
	uint8_t dlc = frame->dlc > APP_CAN_MESSAGE_MAX_DLC ? APP_CAN_MESSAGE_MAX_DLC : frame->dlc;

	message->id = frame->id;
	message->extended_id = (frame->flags & CAN_FRAME_IDE) != 0;
	message->dlc = dlc;
	memcpy(message->data, frame->data, dlc);
	message->timestamp_ms = (uint64_t)k_uptime_get();
}

static void rx_thread_entry(void *arg1, void *arg2, void *arg3)
{
	ARG_UNUSED(arg1);
	ARG_UNUSED(arg2);
	ARG_UNUSED(arg3);

	struct can_frame frame;
	struct app_can_message message;
	char line[CAN_FORMATTER_LINE_LEN];

	while (1) {
		k_msgq_get(&rx_msgq, &frame, K_FOREVER);

		frame_to_message(&frame, &message);

		switch (app_logic_handle_message(&rx_logic_state, &message)) {
		case APP_LOGIC_ACTION_PRINT:
			if (can_formatter_format(&message, line, sizeof(line), NULL) ==
			    CAN_FORMATTER_OK) {
				printk("%s\n", line);
			}
			break;
		case APP_LOGIC_ACTION_HELLO:
			printk("hello specialized\n");
			break;
		case APP_LOGIC_ACTION_NONE:
			break;
		case APP_LOGIC_ACTION_INVALID_ARGS:
		default:
			/* Not expected on this path: rx_logic_state and message are
			 * always valid local objects. Logged rather than treated as
			 * fatal, since dropping one frame is not worth a panic.
			 */
			printk("app_logic_handle_message rejected its arguments\n");
			break;
		}
	}
}

int runtime_start_rx_printer(const struct app_config *config)
{
	/* Separate filters for standard and extended IDs: can_filter's IDE
	 * flag is matched exactly, not masked, so a single filter cannot
	 * catch-all across both ID kinds.
	 */
	const struct can_filter std_filter = {.id = 0, .mask = 0, .flags = 0};
	const struct can_filter ext_filter = {.id = 0, .mask = 0, .flags = CAN_FILTER_IDE};
	int ret;

	if (config == NULL) {
		return -EINVAL;
	}

	if (rx_printer_started) {
		return 0;
	}

	if (!device_is_ready(can_dev)) {
		return -ENODEV;
	}

	if (!app_logic_init(&rx_logic_state, &config->start_trigger, &config->stop_trigger,
			     &config->hello_trigger)) {
		return -EINVAL;
	}

	ret = can_add_rx_filter_msgq(can_dev, &rx_msgq, &std_filter);
	if (ret < 0) {
		return ret;
	}

	ret = can_add_rx_filter_msgq(can_dev, &rx_msgq, &ext_filter);
	if (ret < 0) {
		return ret;
	}

	k_thread_create(&rx_thread_data, rx_thread_stack, K_THREAD_STACK_SIZEOF(rx_thread_stack),
			rx_thread_entry, NULL, NULL, NULL, RX_THREAD_PRIORITY, 0, K_NO_WAIT);

	rx_printer_started = true;

	return 0;
}

#if defined(CONFIG_APP_SMOKE_TEST_INJECT_TRIGGERS)

#define SMOKE_INJECTOR_STEP_DELAY_MS 600

struct smoke_injector_context {
	struct k_work_delayable work;
	struct can_frame start_frame;
	struct can_frame hello_frame;
	struct can_frame stop_frame;
	bool start_enabled;
	bool hello_enabled;
	bool stop_enabled;
	int step;
};

static struct smoke_injector_context smoke_ctx;

static void smoke_send(const struct can_frame *frame, const char *trigger_name)
{
	int ret = can_send(can_dev, frame, K_MSEC(100), NULL, NULL);

	if (ret != 0) {
		printk("Smoke: failed to send %s trigger ID 0x%x: %d\n", trigger_name, frame->id,
		       ret);
	} else {
		printk("Smoke: sent %s trigger ID 0x%x\n", trigger_name, frame->id);
	}
}

static void smoke_injector_work_handler(struct k_work *work)
{
	struct k_work_delayable *dwork = k_work_delayable_from_work(work);
	struct smoke_injector_context *ctx =
		CONTAINER_OF(dwork, struct smoke_injector_context, work);

	switch (ctx->step) {
	case 0:
		if (ctx->start_enabled) {
			smoke_send(&ctx->start_frame, "start");
		}
		break;
	case 1:
		if (ctx->hello_enabled) {
			smoke_send(&ctx->hello_frame, "hello");
		}
		break;
	case 2:
		if (ctx->stop_enabled) {
			smoke_send(&ctx->stop_frame, "stop");
		}
		return; /* one-shot sequence, nothing left to schedule */
	}

	ctx->step++;
	k_work_reschedule(dwork, K_MSEC(SMOKE_INJECTOR_STEP_DELAY_MS));
}

static struct can_frame trigger_to_frame(const struct app_trigger_config *trigger)
{
	return (struct can_frame){
		.id = trigger->id,
		.flags = trigger->extended_id ? CAN_FRAME_IDE : 0,
		.dlc = 0,
	};
}

int runtime_start_smoke_injector(const struct app_config *config)
{
	if (config == NULL) {
		return -EINVAL;
	}

	smoke_ctx.start_frame = trigger_to_frame(&config->start_trigger);
	smoke_ctx.hello_frame = trigger_to_frame(&config->hello_trigger);
	smoke_ctx.stop_frame = trigger_to_frame(&config->stop_trigger);
	smoke_ctx.start_enabled = config->start_trigger.enabled;
	smoke_ctx.hello_enabled = config->hello_trigger.enabled;
	smoke_ctx.stop_enabled = config->stop_trigger.enabled;
	smoke_ctx.step = 0;

	k_work_init_delayable(&smoke_ctx.work, smoke_injector_work_handler);
	k_work_schedule(&smoke_ctx.work, K_MSEC(SMOKE_INJECTOR_STEP_DELAY_MS));

	return 0;
}

#else

int runtime_start_smoke_injector(const struct app_config *config)
{
	ARG_UNUSED(config);

	return 0;
}

#endif /* CONFIG_APP_SMOKE_TEST_INJECT_TRIGGERS */
```

## src/zephyr_app_config.c
```c
#include <zephyr/sys/util.h>

#include "specialized/zephyr_app_config.h"

void zephyr_app_config_load(struct app_config *config)
{
	config->can.bitrate = CONFIG_APP_CAN_BITRATE;
	config->can.sample_point_permille = CONFIG_APP_CAN_SAMPLE_POINT_PERMILLE;
	config->can.loopback = IS_ENABLED(CONFIG_APP_CAN_LOOPBACK);
	config->can.rx_queue_depth = CONFIG_APP_CAN_RX_QUEUE_DEPTH;

	config->tx[0].id = CONFIG_APP_TX1_ID;
	config->tx[0].extended_id = IS_ENABLED(CONFIG_APP_TX1_EXTENDED_ID);
	config->tx[0].period_ms = CONFIG_APP_TX1_PERIOD_MS;

	config->tx[1].id = CONFIG_APP_TX2_ID;
	config->tx[1].extended_id = IS_ENABLED(CONFIG_APP_TX2_EXTENDED_ID);
	config->tx[1].period_ms = CONFIG_APP_TX2_PERIOD_MS;

	config->tx[2].id = CONFIG_APP_TX3_ID;
	config->tx[2].extended_id = IS_ENABLED(CONFIG_APP_TX3_EXTENDED_ID);
	config->tx[2].period_ms = CONFIG_APP_TX3_PERIOD_MS;

	config->start_trigger.enabled = IS_ENABLED(CONFIG_APP_START_TRIGGER_ENABLE);
	config->start_trigger.id = CONFIG_APP_START_TRIGGER_ID;
	config->start_trigger.extended_id = IS_ENABLED(CONFIG_APP_START_TRIGGER_EXTENDED_ID);

	config->stop_trigger.enabled = IS_ENABLED(CONFIG_APP_STOP_TRIGGER_ENABLE);
	config->stop_trigger.id = CONFIG_APP_STOP_TRIGGER_ID;
	config->stop_trigger.extended_id = IS_ENABLED(CONFIG_APP_STOP_TRIGGER_EXTENDED_ID);

	config->hello_trigger.enabled = IS_ENABLED(CONFIG_APP_HELLO_TRIGGER_ENABLE);
	config->hello_trigger.id = CONFIG_APP_HELLO_TRIGGER_ID;
	config->hello_trigger.extended_id = IS_ENABLED(CONFIG_APP_HELLO_TRIGGER_EXTENDED_ID);
}
```
